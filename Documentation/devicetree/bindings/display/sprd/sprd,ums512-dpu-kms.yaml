## Documentation/devicetree/bindings/display/sprd/sprd,ums512-dpu-kms.yaml
```yaml
# SPDX-License-Identifier: (GPL-2.0-only OR BSD-2-Clause)
%YAML 1.2
---
$id: http://devicetree.org/schemas/display/sprd/sprd,ums512-dpu-kms.yaml#
$schema: http://devicetree.org/meta-schemas/core.yaml#

title: Unisoc UMS512 DPU KMS (bootloader-initialised DSI)

maintainers:
  - Simeon Huang <hzwhuang@gmail.com>

properties:
  compatible:
    const: sprd,ums512-dpu-kms

  reg:
    minItems: 1
    maxItems: 3

  interrupts:
    maxItems: 1

  clocks:
    minItems: 1
    maxItems: 4

  clock-names:
    items:
      - const: core
      - const: clk
      - const: dpi
      - const: dsi

  width-mm: true

  height-mm: true

  rotation:
    description:
      Display rotation in degrees counter clockwise (0, 90, 180, 270)
    $ref: /schemas/types.yaml#/definitions/uint32
    enum: [0, 90, 180, 270]

  sprd,boot-framebuffer:
    $ref: /schemas/types.yaml#/definitions/phandle

required:
  - compatible
  - reg
  - interrupts
  - clocks
  - clock-names

additionalProperties: false
```

## Documentation/devicetree/bindings/input/touchscreen/novatek,nvt-ts-spi-a8.yaml
```yaml
# SPDX-License-Identifier: (GPL-2.0-only OR BSD-2-Clause)
%YAML 1.2
---
$id: http://devicetree.org/schemas/input/touchscreen/novatek,nvt-ts-spi-a8.yaml#
$schema: http://devicetree.org/meta-schemas/core.yaml#

title: Novatek NT36523B SPI Host-Download Touchscreen (Samsung Galaxy Tab A8)

maintainers:
  - Simeon Huang <hzwhuang@gmail.com>

properties:
  compatible:
    const: novatek,NVT-ts-spi-a8

  reg:
    maxItems: 1

  spi-max-frequency: true

  novatek,swrst-n8-addr:
    $ref: /schemas/types.yaml#/definitions/uint32
    description: Register address for N8 software reset command.

  novatek,spi-rd-fast-addr:
    $ref: /schemas/types.yaml#/definitions/uint32
    description: Register address for fast SPI read prefix.

  novatek,resolution:
    $ref: /schemas/types.yaml#/definitions/uint32-array
    minItems: 2
    maxItems: 2
    description: Panel touch X and Y resolution in pixels.

  novatek,area-size:
    $ref: /schemas/types.yaml#/definitions/uint32-array
    minItems: 3
    maxItems: 3
    description: Touch pressure/area scaling parameters.

  novatek,max_touch_num:
    $ref: /schemas/types.yaml#/definitions/uint32
    description: Maximum number of simultaneous touch slots.

  novatek,reset-gpio:
    maxItems: 1

  novatek,irq-gpio:
    maxItems: 1

  novatek,fw_name:
    $ref: /schemas/types.yaml#/definitions/string
    description: Host-download firmware filename under /lib/firmware.

required:
  - compatible
  - reg
  - novatek,reset-gpio
  - novatek,irq-gpio

additionalProperties: false

examples:
  - |
    #include <dt-bindings/gpio/gpio.h>
    #include <dt-bindings/interrupt-controller/arm-gic.h>
    spi {
        #address-cells = <1>;
        #size-cells = <0>;
        touchscreen@1 {
            compatible = "novatek,NVT-ts-spi-a8";
            reg = <1>;
            spi-max-frequency = <9600000>;
            novatek,swrst-n8-addr = <0x0003f0fe>;
            novatek,spi-rd-fast-addr = <0x0003f310>;
            novatek,resolution = <1200 1920>;
            novatek,area-size = <0x38 0x70 0x3c>;
            novatek,max_touch_num = <10>;
            novatek,reset-gpio = <&ap_gpio 145 GPIO_ACTIVE_HIGH>;
            novatek,irq-gpio = <&eic_async 0 IRQ_TYPE_EDGE_RISING>;
            novatek,fw_name = "nt36523b_qc_inx_fw.bin";
        };
    };
...
```

## Documentation/devicetree/bindings/net/sprd,mtty.yaml
```yaml
# SPDX-License-Identifier: (GPL-2.0-only OR BSD-2-Clause)
%YAML 1.2
---
$id: http://devicetree.org/schemas/net/sprd,mtty.yaml#
$schema: http://devicetree.org/meta-schemas/core.yaml#

title: Unisoc Marlin3 / UWE5622 Bluetooth TTY-over-SDIO Bridge

maintainers:
  - Simeon <simeon@localhost>

properties:
  compatible:
    const: sprd,mtty

  sprd,name:
    $ref: /schemas/types.yaml#/definitions/string
    description: TTY device name (e.g. ttyBT)

required:
  - compatible
  - sprd,name

additionalProperties: false
```

## Documentation/devicetree/bindings/net/wireless/sprd,marlin3.yaml
```yaml
# SPDX-License-Identifier: (GPL-2.0-only OR BSD-2-Clause)
%YAML 1.2
---
$id: http://devicetree.org/schemas/net/wireless/sprd,marlin3.yaml#
$schema: http://devicetree.org/meta-schemas/core.yaml#

title: Unisoc Marlin3 / UWE5622 Wireless Connectivity (WCN) Platform Controller

maintainers:
  - Simeon <simeon@localhost>

properties:
  compatible:
    enum:
      - sprd,marlin3
      - unisoc,uwe_bsp

  sdhci-name:
    $ref: /schemas/types.yaml#/definitions/phandle
    description: Phandle to the SDIO host controller connected to the WCN chip

  dvdd12-supply:
    description: 1.2V digital core power regulator

  avdd12-supply:
    description: 1.2V analog power regulator

  avdd33-supply:
    description: 3.3V Wi-Fi PA power regulator

  dcxo18-supply:
    description: 1.8V DCXO crystal oscillator power regulator

  rfcustom-supply:
    description: Optional RF front-end switch power regulator

  clocks:
    minItems: 1
    maxItems: 3

  clock-names:
    minItems: 1
    maxItems: 3
    items:
      - const: clk_32k
      - const: source
      - const: enable

  xtal-26m-clk-type:
    enum:
      - TSX
      - TCXO

  enable-gpios:
    maxItems: 1
    description: Chip enable GPIO (active high)

  reset-gpios:
    maxItems: 1
    description: Reset / BT enable GPIO (active high)

  m2-to-ap-irq-gpios:
    maxItems: 1
    description: Public interrupt GPIO from WCN CP2 to AP

  m2-wakeup-ap-gpios:
    maxItems: 1
    description: WCN wakeup AP GPIO

  permit-ap-send-gpios:
    maxItems: 1
    description: Allow AP TX GPIO

  m2-to-ap-coexist-gpios:
    maxItems: 1
    description: WCN to AP coexistence GPIO

  adma-tx:
    type: boolean
    description: Enable SDIO ADMA TX mode

  adma-rx:
    type: boolean
    description: Enable SDIO ADMA RX mode

  data-irq:
    type: boolean
    description: Use in-band SDIO DAT1 interrupt

  rx-polling:
    type: boolean
    description: Use RX polling instead of interrupt

  blksz-512:
    type: boolean
    description: Use 512-byte SDIO block size

  pwrseq:
    type: boolean
    description: Use standard mmc-pwrseq power sequence

  keep-power-on:
    type: boolean
    description: Keep WCN chip powered on after probe/close

  bound-avdd12:
    type: boolean
    description: Hardware-bound avdd12 regulator control

  bound-dcxo18:
    type: boolean
    description: Hardware-bound dcxo18 regulator control

required:
  - compatible
  - sdhci-name

additionalProperties: false
```

## Documentation/devicetree/bindings/net/wireless/sprd,sc2355-wifi.yaml
```yaml
# SPDX-License-Identifier: (GPL-2.0-only OR BSD-2-Clause)
%YAML 1.2
---
$id: http://devicetree.org/schemas/net/wireless/sprd,sc2355-wifi.yaml#
$schema: http://devicetree.org/meta-schemas/core.yaml#

title: Unisoc SC2355 / UWE5622 SDIO WLAN Platform Interface

maintainers:
  - Simeon <simeon@localhost>

properties:
  compatible:
    enum:
      - sprd,sc2355-wifi
      - sprd,unisoc-wifi

required:
  - compatible

additionalProperties: false
```

## Documentation/devicetree/bindings/power/supply/sc27xx-fg.yaml
```yaml
# SPDX-License-Identifier: GPL-2.0
%YAML 1.2
---
$id: http://devicetree.org/schemas/power/supply/sc27xx-fg.yaml#
$schema: http://devicetree.org/meta-schemas/core.yaml#

title: Spreadtrum SC27XX PMICs Fuel Gauge Unit Power Supply

maintainers:
  - Sebastian Reichel <sre@kernel.org>

allOf:
  - $ref: power-supply.yaml#

properties:
  compatible:
    enum:
      - sprd,sc2720-fgu
      - sprd,sc2721-fgu
      - sprd,sc2723-fgu
      - sprd,sc2730-fgu
      - sprd,sc2731-fgu

  reg:
    maxItems: 1

  battery-detect-gpios:
    maxItems: 1

  bat-detect-gpio:
    maxItems: 1
    deprecated: true
    description: use battery-detect-gpios instead

  interrupts:
    maxItems: 1

  io-channels:
    items:
      - description: Battery Temperature ADC
      - description: Battery Charge Voltage ADC

  io-channel-names:
    items:
      - const: bat-temp
      - const: charge-vol

  nvmem-cells:
    maxItems: 1
    description: Calibration cells provided by eFuse device

  nvmem-cell-names:
    const: fgu_calib

  sprd,calib-resistance-micro-ohms:
    description: real resistance of coulomb counter chip in micro Ohms

  sprd,comp-resistance-mohm:
    $ref: /schemas/types.yaml#/definitions/uint32
    description: NTC ground-impedance compensation resistance in milli Ohms

  sprd,voltage-temp-table:
    $ref: /schemas/types.yaml#/definitions/uint32-matrix
    description: |
      NTC lookup table pairing ADC voltage (microvolts, descending) with
      temperature in tenths of a degree Celsius offset by +1000.
    items:
      items:
        - description: NTC ADC voltage in microvolts
        - description: Temperature in decidegrees Celsius plus 1000

  monitored-battery: true

required:
  - compatible
  - reg
  - battery-detect-gpios
  - interrupts
  - io-channels
  - io-channel-names
  - nvmem-cells
  - nvmem-cell-names
  - sprd,calib-resistance-micro-ohms
  - monitored-battery

unevaluatedProperties: false
...
```
